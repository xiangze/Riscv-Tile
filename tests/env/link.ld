/* =============================================================================
   tests/env/link.ld  ―  TileRiscV シミュレーション用リンカスクリプト
   
   TileRiscV の PC リセットベクタは 0x0 なので、
   .text.init を 0x0 から配置する。
   
   メモリマップ
   ─────────────────────────────────────────────────
   0x00000000  .text.init   命令メモリ先頭（_start）
   0x00001000  .tohost      pass/fail 通知領域（未使用）
   0x00002000  .text        その他コード
   0x00003000  .data        データ
               .bss
   0x00010000  スタック上端（sp 初期値）
   ─────────────────────────────────────────────────
   ============================================================================= */

OUTPUT_ARCH("riscv")
ENTRY(_start)

SECTIONS
{
  . = 0x00000000;

  /* ── 命令メモリ ────────────────────────────────────────────────────────── */
  .text.init : {
    *(.text.init)
  }

  . = ALIGN(0x1000);

  /* ── tohost / fromhost（シミュレータ通知用、本実装では gp で代替） ─────── */
  .tohost : {
    *(.tohost)
  }

  . = ALIGN(0x1000);

  /* ── その他コード ─────────────────────────────────────────────────────── */
  .text : {
    *(.text)
    *(.text.*)
  }

  . = ALIGN(0x1000);

  /* ── データ ────────────────────────────────────────────────────────────── */
  .data : {
    *(.data)
    *(.data.*)
  }

  .bss : {
    *(.bss)
    *(.bss.*)
    *(COMMON)
  }

  _end = .;
}
